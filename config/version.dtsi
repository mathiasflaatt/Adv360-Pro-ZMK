#define VERSION_MACRO
macro_ver: macro_ver {
compatible = "zmk,behavior-macro";
label = "macro_ver";
#binding-cells = <0>;
bindings = <&kp N2>, <&kp N0>, <&kp N2>, <&kp N3>, <&kp N1>, <&kp N2>, <&kp N1>, <&kp N2>, <&kp MINUS>, <&kp C>, <&kp O>, <&kp L>, <&kp E>, <&kp MINUS>, <&kp N3>, <&kp N1>, <&kp N2>, <&kp N1>, <&kp F>, <&kp N8>, <&kp N1>, <&kp RET>;
};
