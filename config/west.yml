## config/west.yml
```yaml
manifest:
  remotes:
    - name: zmkfirmware
      url-base: https://github.com/zmkfirmware
    - name: mathiasflaatt
      url-base: https://github.com/mathiasflaatt
  projects:
    - name: zmk
      repo-path: zmk-adv360
      remote: mathiasflaatt
      revision: adv360-z3.2-mf
      import: app/west.yml
  self:
    path: config
```
